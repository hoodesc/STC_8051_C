#include<STC12C2052AD.H> //头文件

//unsigned char a;
sbit LED = P1 ^ 7;
sbit KEY = P1 ^ 0;
/*********************************************************************************************
函数名：毫秒级CPU延时函数
调  用：DELAY_MS (?);
参  数：1~65535（参数不可为0）
返回值：无
结  果：占用CPU方式延时与参数数值相同的毫秒时间
备  注：应用于1T单片机时i<600，应用于12T单片机时i<125
/*********************************************************************************************/
void DELAY_MS (unsigned int a){
	unsigned int i;
	while( a-- != 0){
		for(i = 0; i < 600; i++);
	}
}
/*********************************************************************************************/
void main (void){
	//PWM_init(); //PWM初始化
	KEY = 1;
	LED = 1;
	while(1){
		

	if (KEY == 0){
		 DELAY_MS (100);
		 if (KEY == 0){
		 if(LED == 0){
		 LED = 1;
		}
	   else{
			LED = 0;
	    }
		 }
   }



}
}

