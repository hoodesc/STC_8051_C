#include <reg52.h>
#include <intrins.h>

typedef unsigned char uchar;
typedef unsigned int uint;

uchar code Number[] = {'0','1','2','3','4','5','6','7','8','9'};
uchar Tem[] = {0,0,'.',0,0xA1,0xE6};
uchar code TAB[] = "状态：";
uchar code TAB1[] = "正常    ";
uchar code TAB2[] = "有害气体";
uchar code TAB3[] = "温度过高";
uchar code TAB4[] = "温度：";

bit C4H10_Flag = 0;
bit OC_Flag = 0;

uchar code PHOTO[] = {
0x00,0x00,0x00,0x00,0x00,0x00,0x00,0x00,0x00,0x00,0x00,0x00,0x00,0x00,0x00,0x00,
0x00,0x00,0x00,0x00,0x00,0x00,0x00,0x40,0x00,0x00,0x00,0x00,0x00,0x00,0x00,0x00,
0x00,0x00,0x00,0x00,0x00,0x00,0x00,0xC0,0x00,0x00,0x00,0x00,0x00,0x00,0x00,0x00,
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0x00,0x00,0x00,0x00,0x00,0x00,0x00,0x00,0x00,0x00,0x00,0x00,0x00,0x00,0x00,0x00
};
#define COM 0xF8		  
#define DAT 0xFA
// LCD12864液晶位
sbit CS  = P1^3;	// 串行片选
sbit SID = P1^2;	// 串行数据
sbit CLK = P1^1;	// 串行时钟
// DS18B20温度传感器
sbit DQ = P1^0;		// DS18B20 数据总线
sbit LED = P1^6;
// MQ-2
sbit Waring = P3^2;
// 函数声明
void delay(uint us);					// 2us延时函数
void DelayMs(uint ms);				// ms延时函数

void DS18B20_Init();
void compute(uchar lsb,uchar msb);		// 温度计算
uchar DS18B20_Read();
void DS18B20_Write(uchar udata);

void LCD12864_Init();
void LCD_Write_Byte(uchar dat);			// LCD写字节
void LCD_Write_Dat(uchar dat);
void LCD_Write_Com(uchar com);
void LCD_XY(uchar x,y);
void Photo(uchar *pPic);				// LCD写图片

/*第一字节：串口控制—格式 11111ABC
A 为数据传送方向控制：H 表示数据从 LCD 到 MCU，L 表示数据从 MCU 到 LCD
B 为数据类型选择：H 表示数据是显示数据，L 表示数据是控制指令
C 固定为 0
*/

//	LCD写数据函数
void LCD_Write_Com(uchar com)
{
	uchar MSB,LSB;
	MSB = (com & 0xF0);
	LSB = (com <<= 4);
	LCD_Write_Byte(COM);		// 写入指令
	LCD_Write_Byte(MSB);		// 写入指令高8位
	LCD_Write_Byte(LSB);		// 写入指令低8位
}

//	LCD写指令函数
void LCD_Write_Dat(uchar dat)
{
	uchar MSB,LSB;
	MSB = (dat & 0xF0);
	LSB = (dat <<= 4);
	LCD_Write_Byte(DAT);		// 写入数据
	LCD_Write_Byte(MSB);		// 写入数据高8位
	LCD_Write_Byte(LSB);		// 写入数据低8位
}

//	LCD写入一字节
void LCD_Write_Byte(uchar dat)
{
	uchar i;
	for(i = 0; i < 8; i++)
	{
		CLK = 0;
		if(dat & 0x80)
			SID = 1;
		else
			SID = 0;
		CLK = 1;
		dat <<= 1;
	}
}
void LCD_Display(uchar x,uchar y,uchar *pDisplayData)
{
	LCD_XY(x,y);
	while(*pDisplayData != '\0')
		LCD_Write_Dat(*pDisplayData++);
}

void LCD_XY(uchar x,y)
{
	uchar uX,XY;
	if(1 == x)
		uX = 0x80;		// 第一行
	else if(2 == x)
		uX = 0x90;		// 第二行
	else if(3 == x)
		uX = 0x88;		// 第三行
	else if(4 == x)		
		uX = 0x98;		// 第四行
	XY = uX+y;
	LCD_Write_Com(XY);
}

void LCD12864_Init()
{
	CS = 1;		
	LCD_Write_Com(0x30);		// 功能设置：基本指令
	DelayMs(10);
	LCD_Write_Com(0x01);		// 清屏
	DelayMs(10);
	LCD_Write_Com(0x0C);		// 显示状态：开显示，游标关闭
	DelayMs(10);	
}

//	11.0592Mhz 约1ms延时
void DelayMs(uint ms)
{
	uchar i,j;
	while(ms--)
	{
		for(i = 0; i < 9; i++)
			for(j = 0; j < 177; j++);
	}	
}
// 11.0592Mhz 约2us延时
void delay(uint us)		
{	
	uint i;
	for(i = 0; i < us; i++)
		_nop_();
}


void Photo(uchar *pPic)
{
	uchar i,j;
	LCD_Write_Com(0x34);		// 扩充指令，关绘图显示
	// 先写上半屏
	for(i = 0; i < 32; i++)
	{
		LCD_Write_Com(0x80 + i);	// 写水平坐标
		LCD_Write_Com(0x80);		// 写垂直坐标 	
		for(j = 0; j < 16; j++)
		{
			LCD_Write_Dat(*pPic++);	
		}
	}
	// 再写下半屏
	for(i = 0; i < 32; i++)
	{
		LCD_Write_Com(0x80 + i);	// 写水平坐标
		LCD_Write_Com(0x88);		// 写垂直坐标 	
		for(j = 0; j < 16; j++)
		{
			LCD_Write_Dat(*pPic++);	
		}
	}
	LCD_Write_Com(0x36);		// 扩充指令，开绘图显示
}

void DS18B20_Write(uchar udata)
{
	uchar i;
	uchar dat;
	for(i = 0; i < 8; i++)
	{
		dat = udata & 0x01;
		udata = udata >> 1;		// udata右移一位准备下一次送上总线
		if(dat)
		{
			DQ = 0;		// 拉低总线
			delay(1);	// 延时2us
			DQ = 1;		// 送1
			delay(40);	// 延时80us
			DQ = 1;		// 释放总线
			delay(1);	// 延时2us
		}
		else
		{
			DQ = 0;		// 拉低总线
			delay(1);	// 延时2us
			DQ = 0;		// 送0
			delay(40);	// 延时80us;
			DQ = 1;		// 释放总线
			delay(1);	// 延时2us;
		}
	}	
}

uchar DS18B20_Read()
{
	uchar i;
	uchar udata = 0x00;
	for(i = 0; i < 8; i++)
	{
		udata = udata >> 1;	// udata右移一位，第一次移位为空操作
		DQ = 0;			// 拉低总线
		delay(2);		// 延时4us，产生读时隙
		DQ = 1;			// 拉高总线
		if(DQ)
			udata |= 0x80;		// 1：读DQ数据并存放在udata最高位
		else
			udata |= 0x00;		// 0：读DQ数据并存放在udata最高位
		delay(40);		// 延时80us
		DQ = 1;			// 释放总线
		delay(1);		// 延时2us
	}
	return(udata);	
}

void DS18B20_Init()
{
	DQ = 1;			// 拉高总线
	delay(1);
	
	DQ = 0;			// 拉低总线
	delay(350);		// 延时700us	
	DQ = 1;			// 释放总线
	delay(15);		// 延时30us
	while(DQ);		// 等待DS18B20拉低总线
		//LED = 0;	// 复位成功，点亮LED
	delay(100);		// 延时200us
	DQ = 1;			// 释放总线
	delay(150);		// 延时300us
}

void compute(uchar lsb,uchar msb)
{
	uchar ge,shi,bai;
	uint num;
	uint temp;
	num = msb;
	num  <<= 8;
	num |= lsb;
	temp = num*0.0625*10+0.5;	
	bai = temp/100;  	
	shi = temp%100/10;	
	ge  = temp%100%10;	
	Tem[0] = bai;
	Tem[1] = shi;
	Tem[3] = ge;
	Tem[0] = Number[Tem[0]];
	Tem[1] = Number[Tem[1]];
	Tem[3] = Number[Tem[3]];
}

void Uart_ISR() interrupt 4
{
	uchar temp;
//	uchar *pChar;
	uchar i;
	if(RI)
	{
		RI = 0;
		temp = SBUF;
	}
	if(temp == '1')
	{
		for(i = 0; i < 4; i++)
		{
			SBUF = Tem[i];
			while(!TI);
			TI = 0;
		}
		SBUF = '\n';
		while(!TI);
		TI = 0;
		temp = 0;
	}
//	else if(temp == '2')
//	{
//		*pChar = TAB;
//		if(!C4H10_Flag && !OC_Flag)	   // 正常
//		{
//			for(i = 0; i < 8; i++)
//			{
//				SBUF = *pChar++;
//				while(!TI);
//				TI = 0;
//			}
//			SBUF = '\n';
//			while(!TI);
//			TI = 0;
//			temp = 0; 
//		}
//		else if(C4H10_Flag && OC_Flag)
//		{
//			// 温度，气体同时报警
//		}
//		else if(C4H10_Flag)
//		{
//			// 有害气体
//		}
//		else if(OC_Flag)
//		{
//			// 温度过高
//		}		
}

/*  11.0592Mhz	Uart串口初始化		    */
void Uart_Init()	// 串口初始化
{
	TMOD &= 0x0F;	// 保留后定时器0设置，清空定时器1设置
	TMOD |= 0x20;	// 定时器1 模式2
	SCON |= 0x50;	// 串口方式1，8位UART波特率可变，可接收
	TH1   = 0xFD;	// TL1溢出后将TH1的值装入
	TL1   = 0xFD;	// 9600bps
	ET1   = 0;		// 关闭定时器1中断
	ES    = 1;
	TR1   = 1;		// 开定时器1
}
/**********************************/
void Timer0_ISR() interrupt 1
{
	TL0 = 0x00;			// 设置定时初值		10ms
	TH0 = 0xDC;			// 设置定时重载值
	if(!Waring)
		C4H10_Flag = 1;	// 有害气体标识
	else
		C4H10_Flag = 0;
				
	if(Tem[0] != '2' && Tem[0] != '1' && Tem[0] != '0'  )
		OC_Flag = 1;		// 温度过高
	else
		OC_Flag = 0;	
}

void Timer0_Init()
{
	TMOD &= 0xF0;		// 设置定时器模式
	TMOD |= 0x02;		// 设置定时器模式
	TL0 = 0x00;			// 设置定时初值		10ms
	TH0 = 0xDC;			// 设置定时重载值
	TF0 = 0;			// 清除TF0标志
	ET0 = 1;			// 定时器0 允许中断
	EA  = 1;
	TR0 = 1;
}

void main()
{
	DelayMs(10);			
	Uart_Init();			// 串口初始化
	LCD12864_Init();		// LCD12864初始化	
	Photo(PHOTO);
	DelayMs(800);			// 图片显示时间
	LCD_Write_Com(0x34);	// 扩充指令、关闭绘图显
	LCD12864_Init();
	LCD_Display(1,0,TAB);		// 第一行。一列  状胎：
	LCD_Display(4,2,TAB4);		// 第四行，三列  温度：
	while(1)
	{
		// 初始化并启动温度转换
		DS18B20_Init();			// DS18B20初始化
		DS18B20_Write(0xCC);	// 跳过ROM地址
		DS18B20_Write(0x44);	// 启动温度转换
		DelayMs(1000);
		// 初始化，读温度
		DS18B20_Init();			// DS18B20初始化
		DS18B20_Write(0xCC);	// 跳过ROM地址
		DS18B20_Write(0xBE);	// 读取RAM命令
		compute(DS18B20_Read(),DS18B20_Read());		// 	先读低8位，再读高八位
		Timer0_Init();			// 定时器0初始化
		if(C4H10_Flag)
			LCD_Display(1,3,TAB2);		// 有害气体
		else if(!OC_Flag && !C4H10_Flag)
			LCD_Display(1,3,TAB1);		// 正常
		if(OC_Flag)
			LCD_Display(1,3,TAB3);		// 温度过高
		else if(!OC_Flag && !C4H10_Flag)
			LCD_Display(1,3,TAB1);
				
		LCD_Display(4,5,Tem);		// 温度刷新：xx.xx℃				
	}
}