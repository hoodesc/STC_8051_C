#include <stc15.h>

typedef unsigned char uchar;
typedef unsigned int uint;

uchar code TAB[] = "    PHICOMM";
uchar code PHOTO[] = {
0x00,0x00,0x00,0x00,0x00,0x00,0x00,0x00,0x00,0x00,0x00,0x00,0x00,0x00,0x00,0x00,
0x00,0x00,0x00,0x00,0x00,0x00,0x00,0x40,0x00,0x00,0x00,0x00,0x00,0x00,0x00,0x00,
0x00,0x00,0x00,0x00,0x00,0x00,0x00,0xC0,0x00,0x00,0x00,0x00,0x00,0x00,0x00,0x00,
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0x00,0x00,0x00,0x00,0x00,0x00,0x00,0x00,0x00,0x00,0x00,0x00,0x00,0x00,0x00,0x00
};
#define COM 0xF8		  
#define DAT 0xFA

//sbit CS  = P3^3;	// 串行片选
//sbit SID = P3^4;	// 串行数据
//sbit CLK = P3^5;	// 串行时钟

sbit CS  = P0^0;	// 串行片选
sbit SID = P0^1;	// 串行数据
sbit CLK = P0^2;	// 串行时钟

void LCD_Write_Byte(uchar dat);
void DelayMs(uchar time);
void Photo(uchar *pPic);

/*第一字节：串口控制—格式 11111ABC
A 为数据传送方向控制：H 表示数据从 LCD 到 MCU，L 表示数据从 MCU 到 LCD
B 为数据类型选择：H 表示数据是显示数据，L 表示数据是控制指令
C 固定为 0
*/

//	写数据函数
void LCD_Write_Com(uchar com)
{
	uchar MSB,LSB;
	MSB = (com & 0xF0);
	LSB = (com <<= 4);
	LCD_Write_Byte(COM);		// 写入指令
	LCD_Write_Byte(MSB);		// 写入指令高8位
	LCD_Write_Byte(LSB);		// 写入指令低8位
}

//	写指令函数
void LCD_Write_Dat(uchar dat)
{
	uchar MSB,LSB;
	MSB = (dat & 0xF0);
	LSB = (dat <<= 4);
	LCD_Write_Byte(DAT);		// 写入数据
	LCD_Write_Byte(MSB);		// 写入数据高8位
	LCD_Write_Byte(LSB);		// 写入数据低8位
}

//	写入一字节
void LCD_Write_Byte(uchar dat)
{
	uchar i;
	for(i = 0; i < 8; i++)
	{
		CLK = 0;
		if(dat & 0x80)
			SID = 1;
		else
			SID = 0;
		CLK = 1;
		dat <<= 1;
	}
}

//void DecideBusyBit()
//{
//	CLK = 0;
//	
//}

void LCD_XY(uchar x,y)
{
	uchar uX,XY;
	if(1 == x)
		uX = 0x80;		// 第一行
	else if(2 == x)
		uX = 0x90;		// 第二行
	else if(3 == x)
		uX = 0x88;		// 第三行
	else if(4 == x)		
		uX = 0x98;		// 第四行
	XY = uX+y;
	LCD_Write_Com(XY);
}

void LCD12864_Init()
{
	CS = 1;		
	LCD_Write_Com(0x30);		// 功能设置：基本指令
	DelayMs(10);
	LCD_Write_Com(0x01);		// 清屏
	DelayMs(10);
	LCD_Write_Com(0x0C);		// 显示状态：开显示，游标关闭
	DelayMs(10);	
}

//	11.0592Mhz延时函数，约1ms
void DelayMs(uchar time)
{
	uchar i,j;
	while(time--)
	{
		for(i = 0; i < 9; i++)
			for(j = 0; j < 177; j++);
	}	
}

void Photo(uchar *pPic)
{
	uchar i,j;
	LCD_Write_Com(0x34);		// 扩充指令，关绘图显示
	// 先写上半屏
	for(i = 0; i < 32; i++)
	{
		LCD_Write_Com(0x80 + i);	// 写水平坐标
		LCD_Write_Com(0x80);		// 写垂直坐标 	
		for(j = 0; j < 16; j++)
		{
			LCD_Write_Dat(*pPic++);	
		}
	}
	// 再写下半屏
	for(i = 0; i < 32; i++)
	{
		LCD_Write_Com(0x80 + i);	// 写水平坐标
		LCD_Write_Com(0x88);		// 写垂直坐标 	
		for(j = 0; j < 16; j++)
		{
			LCD_Write_Dat(*pPic++);	
		}
	}
	LCD_Write_Com(0x36);		// 扩充指令，开绘图显示



}

void main()
{
	uchar i;
	DelayMs(10);
	LCD12864_Init();
	while(1)
	{
		Photo(PHOTO);
		while(1);
//
//		LCD_XY(1,0);	// 第一行第一列
//		while(TAB[i] != '\0')
//		{
//			LCD_Write_Dat(TAB[i]);
//			i++;
//		}
		while(1);
	}
}